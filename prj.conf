## CMakeLists.txt
```
# SPDX-License-Identifier: Apache-2.0
cmake_minimum_required(VERSION 3.20.0)

find_package(Zephyr REQUIRED HINTS $ENV{ZEPHYR_BASE})
project(gpio_prj)

FILE(GLOB app_sources
    src/*.cpp
)

target_sources(app PRIVATE ${app_sources})

# Libraries

# Include
zephyr_include_directories(
    src
)
```

## prj.conf
```kconfig
# Config Peripherals
CONFIG_GPIO=y
####

# CPP
CONFIG_CPP=y
CONFIG_STD_CPP14=y
####

# Config
CONFIG_FPU=y
CONFIG_RESET_ON_FATAL_ERROR=n
CONFIG_ASSERT=y
CONFIG_RING_BUFFER=y
####

# Config LOGGER
CONFIG_LOG=y
CONFIG_USE_SEGGER_RTT=y
CONFIG_LOG_BACKEND_RTT=y
CONFIG_LOG_BACKEND_UART=n
CONFIG_LOG_PRINTK=y
CONFIG_LOG_MODE_IMMEDIATE=n
####
```

## src/main.cpp
```c
#include <zephyr/kernel.h>
#include <zephyr/device.h>

#include "Gpio.h"

#define LOG_LEVEL CONFIG_LOG_DEFAULT_LEVEL
#include <zephyr/logging/log.h>
LOG_MODULE_REGISTER(main);

// Method-1 to setup GPIO pins.
// static const struct device *port0 = DEVICE_DT_GET(DT_NODELABEL(gpio0));

// GpioOutput  led0(port0, 13);
// GpioOutput  led1(port0, 14);
// GpioInput   btn1(port0, 11);

// Method-2 to setup GPIO pins.
static const struct gpio_dt_spec dt_led0 = GPIO_DT_SPEC_GET(DT_ALIAS(led0), gpios);
static const struct gpio_dt_spec dt_led1 = GPIO_DT_SPEC_GET(DT_ALIAS(led1), gpios);
static const struct gpio_dt_spec dt_btn1 = GPIO_DT_SPEC_GET(DT_ALIAS(sw0), gpios);

GpioOutput  led0(dt_led0);
GpioOutput  led1(dt_led1);
GpioInput   btn1(dt_btn1);

// Global variables
bool state = false;


void btn1_handler(const struct device *dev, struct gpio_callback *cb,
           uint32_t pins)
{
    LOG_INF("btn1 interrupt occurs...");
}

int main(void)
{
	LOG_INF("Zephyr RTOS C++ Gpio example...");	

    int status = led0.IsReady();
    if(status != 0)
        LOG_ERR("led0 port is not ready!");

    status = led1.IsReady();
    if(status != 0)
        LOG_ERR("led1 port is not ready!");

    status = btn1.IsReady();
    if(status != 0)
        LOG_ERR("btn1 port is not ready!");

    status = btn1(Gpio::Bias::PULL_UP);
    if(status != 0)
        LOG_ERR("btn1 configuration error!");

    status = btn1(Gpio::ModeInterrupt::EDGE_FALLING);
    if(status != 0)
        LOG_ERR("btn1 interrupt configuration error!");

    status = btn1.AddCallback(btn1_handler);
    if(status != 0)
        LOG_ERR("btn1 add callback error!");
    
    status = led0();
    if(status != 0)
        LOG_ERR("led0 configuration error!");

    status = led1(Gpio::ModeOutput::OUTPUT_HIGH);
    if(status != 0)
        LOG_ERR("led1 configuration error!");

    led0 = true; // Set led0 pin to high...

    while(1)
    {
        status = !led0;
        if(status != 0)
            LOG_ERR("led0 toggle error!");

        status = led1 << state;
        state = !state;
        if(status != 0)
            LOG_ERR("led1 set error!");

        Gpio::Level btn_state = Gpio::Level::LOW;
        status = btn1>>btn_state;
        if(status != 0)
            LOG_ERR("btn1 read error!");

        LOG_INF("btn1 level is %d...", static_cast<int>(btn_state));

        k_sleep(K_MSEC(1000));
    }
}
```

## src/Gpio.h
```c
#ifndef PIN_H__
#define PIN_H__

#include <zephyr/kernel.h>
#include <zephyr/drivers/gpio.h>

namespace Gpio
{
    enum class ModeOutput
    {
        OUTPUT_LOW = GPIO_OUTPUT_LOW, // Configures GPIO pin as output and initializes it to a low state.
        OUTPUT_HIGH = GPIO_OUTPUT_HIGH, // Configures GPIO pin as output and initializes it to a high state.
        OUTPUT_INACTIVE = GPIO_OUTPUT_INACTIVE, // Configures GPIO pin as output and initializes it to a logic 0.
        OUTPUT_ACTIVE = GPIO_OUTPUT_ACTIVE, // Configures GPIO pin as output and initializes it to a logic 1.
    };

    enum class ModeInterrupt
    { 
        DISABLE = GPIO_INT_DISABLE, // Disables GPIO pin interrupt.
        EDGE_RISING = GPIO_INT_EDGE_RISING, // Configures GPIO interrupt to be triggered on pin rising edge and enables it.
        EDGE_FALLING = GPIO_INT_EDGE_FALLING, // Configures GPIO interrupt to be triggered on pin falling edge and enables it.
        EDGE_BOTH = GPIO_INT_EDGE_BOTH, // Configures GPIO interrupt to be triggered on pin rising or falling edge and enables it.
        LEVEL_LOW = GPIO_INT_LEVEL_LOW, // Configures GPIO interrupt to be triggered on pin physical level low and enables it.
        LEVEL_HIGH = GPIO_INT_LEVEL_HIGH, // Configures GPIO interrupt to be triggered on pin physical level high and enables it.
        EDGE_TO_INACTIVE = GPIO_INT_EDGE_TO_INACTIVE, // Configures GPIO interrupt to be triggered on pin state change to logical level 0 and enables it.
        EDGE_TO_ACTIVE = GPIO_INT_EDGE_TO_ACTIVE, // Configures GPIO interrupt to be triggered on pin state change to logical level 1 and enables it.
        LEVEL_INACTIVE = GPIO_INT_LEVEL_INACTIVE, // Configures GPIO interrupt to be triggered on pin logical level 0 and enables it.
        LEVEL_ACTIVE = GPIO_INT_LEVEL_ACTIVE, // Configures GPIO interrupt to be triggered on pin logical level 1 and enables it.
    };

    enum class Drive
    {
        PUSH_PULL = 0,
        OPEN_DRAIN = GPIO_OPEN_DRAIN, // Configures GPIO output in open drain mode (wired AND).
        OPEN_SOURCE = GPIO_OPEN_SOURCE, // Configures GPIO output in open source mode (wired OR).
    };

    enum class Bias
    {
        PULL_NO = 0,
        PULL_UP = GPIO_PULL_UP, // Enables GPIO pin pull-up.
        PULL_DOWN = GPIO_PULL_DOWN, // Enable GPIO pin pull-down.
    };

    enum class Level
    {
        LOW = 0,
        HIGH = 1,
    };
};

class GpioBase
{
    public:
        virtual int IsReady() = 0;
        virtual int Configure(Gpio::Bias const bias, Gpio::Drive const drive) = 0;
        virtual int Disconnect() = 0;
};

class GpioInput : public GpioBase
{
    public:
        GpioInput(const struct device* port, const gpio_pin_t pin);
        GpioInput(const struct gpio_dt_spec gpio_dt);

        int IsReady();
        int Configure(Gpio::Bias const bias = Gpio::Bias::PULL_NO, 
                      Gpio::Drive const drive = Gpio::Drive::PUSH_PULL);
        int ConfigureInterrupt(Gpio::ModeInterrupt const mode_int);
        int Disconnect();
        int IsInput();
        int AddCallback(gpio_callback_handler_t handler);
        int RemoveCallback();
        int Get(Gpio::Level& level);

        int operator () (Gpio::Bias const bias = Gpio::Bias::PULL_NO,
                         Gpio::Drive const drive = Gpio::Drive::PUSH_PULL) 
        {
            return Configure(bias, drive);
        }

        int operator () (Gpio::ModeInterrupt const mode_int) 
        {
            return ConfigureInterrupt(mode_int);
        }

        int operator >> (Gpio::Level& level) 
        {
            return Get(level);
        }

    private:
        const struct device* port_ = nullptr;
        const gpio_pin_t pin_ = 0;
        const gpio_dt_flags_t dt_flags_ = 0;  
        gpio_flags_t flags_ = 0;  
        gpio_flags_t flags_int_ = 0;
        struct gpio_callback gpio_callback_ = {0};
};

class GpioOutput : public GpioBase
{
    public:
        GpioOutput(const struct device* port, const gpio_pin_t pin);
        GpioOutput(const struct gpio_dt_spec gpio_dt);

        int IsReady();
        int Configure(Gpio::Bias const bias = Gpio::Bias::PULL_NO, 
                      Gpio::Drive const drive = Gpio::Drive::PUSH_PULL);
        int Configure(Gpio::ModeOutput const mode, 
                      Gpio::Bias const bias = Gpio::Bias::PULL_NO, 
                      Gpio::Drive const drive = Gpio::Drive::PUSH_PULL);
        int Disconnect();
        int IsOutput();
        int Set();
        int Clear();
        int Toggle();

        int operator () (Gpio::Bias const bias = Gpio::Bias::PULL_NO, 
                         Gpio::Drive const drive = Gpio::Drive::PUSH_PULL) 
        {
            return Configure(bias, drive);
        }

        int operator () (Gpio::ModeOutput const mode, 
                         Gpio::Bias const bias = Gpio::Bias::PULL_NO, 
                         Gpio::Drive const drive = Gpio::Drive::PUSH_PULL) 
        {
            return Configure(mode, bias, drive);
        }

        void operator = (bool state) 
        {
            if (state) {
                Set();
            } else {
                Clear();
            }        
        }

        int operator ! () 
        {
            return Toggle();
        }

        int operator << (bool value) 
        {
            if (value == true) 
                return Set();
            
            return Clear();
        }

    private:

        const struct device* port_ = nullptr;
        const gpio_pin_t pin_ = 0;
        const gpio_dt_flags_t dt_flags_ = 0;  
        gpio_flags_t flags_ = 0;
};

#endif
```

## src/GpioInput.cpp
```c
#include "Gpio.h"

GpioInput::GpioInput(const struct device* port, const gpio_pin_t pin) : port_{port}, pin_{pin}
{
}

GpioInput::GpioInput(const struct gpio_dt_spec gpio_dt) : port_{gpio_dt.port}, pin_{gpio_dt.pin}, dt_flags_{gpio_dt.dt_flags}
{
}

int GpioInput::IsReady()
{
    return (int) !device_is_ready(port_);
}

int GpioInput::Configure(Gpio::Bias const bias, Gpio::Drive const drive)
{
    flags_ = GPIO_INPUT;
    flags_ |= static_cast<gpio_flags_t>(bias);
    flags_ |= static_cast<gpio_flags_t>(drive);
    return gpio_pin_configure(port_, pin_, dt_flags_ | flags_);
}

int GpioInput::ConfigureInterrupt(Gpio::ModeInterrupt const mode_int)
{
    flags_int_ = static_cast<gpio_flags_t>(mode_int);
    return gpio_pin_interrupt_configure(port_, pin_, flags_int_);
}

int GpioInput::Disconnect()
{
    flags_ = 0;
    return gpio_pin_configure(port_, pin_, GPIO_DISCONNECTED);
}

int GpioInput::IsInput()
{
    return gpio_pin_is_input(port_, pin_);
}

int GpioInput::Get(Gpio::Level& level)
{
    int status = gpio_pin_get(port_, pin_);
    if(status < 0)
        return status;

    status == 0 ? level = Gpio::Level::LOW : level = Gpio::Level::HIGH;
    return 0;
}

int GpioInput::AddCallback(gpio_callback_handler_t handler)
{
    gpio_init_callback(&gpio_callback_, handler, BIT(pin_));
    return gpio_add_callback(port_, &gpio_callback_);
}

int GpioInput::RemoveCallback()
{
    return gpio_remove_callback(port_, &gpio_callback_);
}
```

## src/GpioOutput.cpp
```c
#include "Gpio.h"

GpioOutput::GpioOutput(const struct device* port, const gpio_pin_t pin) : port_{port}, pin_{pin}
{
}

GpioOutput::GpioOutput(const struct gpio_dt_spec gpio_dt) : port_{gpio_dt.port}, pin_{gpio_dt.pin}, dt_flags_{gpio_dt.dt_flags}
{
}

int GpioOutput::IsReady()
{
    
    return (int) !device_is_ready(port_);
}

int GpioOutput::Configure(Gpio::Bias const bias, Gpio::Drive const drive)
{
    flags_ = GPIO_OUTPUT;
    flags_ |= static_cast<gpio_flags_t>(bias);
    flags_ |= static_cast<gpio_flags_t>(drive);
    return gpio_pin_configure(port_, pin_, dt_flags_ | flags_);
}

int GpioOutput::Configure(Gpio::ModeOutput const mode, Gpio::Bias const bias, Gpio::Drive const drive)
{
    flags_ |= static_cast<gpio_flags_t>(mode);
    flags_ |= static_cast<gpio_flags_t>(bias);
    flags_ |= static_cast<gpio_flags_t>(drive);
    return gpio_pin_configure(port_, pin_, dt_flags_ | flags_);
}

int GpioOutput::Disconnect()
{
    flags_ = 0;
    return gpio_pin_configure(port_, pin_, GPIO_DISCONNECTED);
}

int GpioOutput::IsOutput()
{
    return gpio_pin_is_output(port_, pin_);
}

int GpioOutput::Set()
{
    return gpio_pin_set(port_, pin_, static_cast<int>(Gpio::Level::HIGH));
}

int GpioOutput::Clear()
{
    return gpio_pin_set(port_, pin_, static_cast<int>(Gpio::Level::LOW));
}

int GpioOutput::Toggle()
{
    return gpio_pin_toggle(port_, pin_);
}
```
